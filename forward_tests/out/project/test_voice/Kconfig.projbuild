## forward_tests/out/project/test_voice/Kconfig.projbuild
```kconfig
menu "test_voice Configuration"

    config APP_WIFI_SSID
        string "WiFi SSID"
        default "myssid"

    config APP_WIFI_PASSWORD
        string "WiFi Password"
        default "mypassword"

    config APP_LVGL_THEME
        int "LVGL Theme (0=dark, 1=light)"
        default 0

endmenu
```

## forward_tests/out/project/test_voice/sdkconfig.defaults
```kconfig
# ESP-IDF Configuration
CONFIG_FREERTOS_HZ=1000
CONFIG_ESP_TASK_WDT_TIMEOUT_S=30
CONFIG_ESP_WIFI_TASK_PINNED_TO_CORE_1=y
CONFIG_SPIRAM=y
CONFIG_SPIRAM_USE_MALLOC=y
CONFIG_LV_COLOR_DEPTH_16=y
CONFIG_BOOTLOADER_APP_ROLLBACK_ENABLE=y
```
